## prj.conf
```kconfig
CONFIG_RESET_ON_FATAL_ERROR=n
CONFIG_SERIAL=n
CONFIG_MAIN_THREAD_PRIORITY=1
CONFIG_SOC_NRF53_ANOMALY_168_WORKAROUND=n
```

## src/main.c
```c
#include "nrf.h"
#include <zephyr/kernel.h>
#include <stdint.h>

uint32_t duration = 3;
uint32_t timer0stop = 80;
void mpsl_RTC0_isr_handler(void)
{
	NRF_RTC0->EVENTS_COMPARE[0] = 0;
	NRF_RTC0->CC[0] = duration;
	NRF_RTC0->TASKS_START = 1;
	if (timer0stop == 120)
	{
		timer0stop = 80;
	}
	else
	{
		timer0stop++;
	}
	NRF_CLOCK->TASKS_HFCLKSTOP=1;
	NRF_CLOCK->EVENTS_HFCLKSTARTED = 0;
	NRF_TIMER0->TASKS_STOP = 1;
	NRF_TIMER0->TASKS_CLEAR = 1;
	NRF_TIMER0->CC[0] = timer0stop;
	NRF_TIMER0->EVENTS_COMPARE[0] =0;
	NRF_TIMER0->TASKS_START = 1;
}

int main(void)
{
	NRF_CLOCK->PUBLISH_HFCLKSTARTED =  0 | (1 << 31);
	NRF_CLOCK->SUBSCRIBE_HFCLKSTART =  10 | (1 << 31);

	NRF_DPPIC->CHENSET = (1 << 10);
	NRF_POWER->PUBLISH_SLEEPENTER =  2 | (1 << 31);
	NRF_POWER->PUBLISH_SLEEPEXIT =  3 | (1 << 31);
	IRQ_CONNECT(RTC0_IRQn, 0,mpsl_RTC0_isr_handler, 0, 0);
	irq_enable(RTC0_IRQn);
	NRF_RTC0->SHORTS = RTC_SHORTS_COMPARE0_CLEAR_Msk;
	NRF_RTC0->CC[0] = duration;
	NRF_RTC0->INTENSET =RTC_INTENSET_COMPARE0_Msk;
	NRF_RTC0->EVTENSET =RTC_INTENSET_COMPARE0_Msk;
	NRF_RTC0->TASKS_START = 1;
	NRF_TIMER0->BITMODE = TIMER_BITMODE_BITMODE_32Bit;
	NRF_TIMER0->SHORTS = TIMER_SHORTS_COMPARE0_STOP_Msk| TIMER_SHORTS_COMPARE0_CLEAR_Msk;
	NRF_TIMER0->CC[0] = timer0stop;
	NRF_TIMER0->PUBLISH_COMPARE[0] = (1 << 31) | 10;
	NRF_TIMER0->TASKS_START = 1;
	while(1)
	{
		k_sleep(K_MSEC(10000));
	}
	return 0;
}
```
