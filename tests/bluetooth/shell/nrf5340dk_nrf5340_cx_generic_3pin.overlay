/* Copyright (c) 2022 Nordic Semiconductor ASA
 *
 * SPDX-License-Identifier: LicenseRef-Nordic-5-Clause
 */

/ {
	nrf_radio_coex: radio_coex_three_wire {
		status = "okay";
		compatible = "generic-radio-coex-three-wire";
		req-gpios =     <&gpio0 5 (GPIO_ACTIVE_HIGH)>;
		pri-dir-gpios = <&gpio0 6 (GPIO_ACTIVE_HIGH)>;
		grant-gpios =   <&gpio0 7 (GPIO_ACTIVE_HIGH | GPIO_PULL_UP)>;
	};
};
